## 3Inch7EPaper/sdkconfig.defaults
```kconfig
CONFIG_IDF_TARGET="esp32s3"
CONFIG_ESPTOOLPY_FLASHSIZE_16MB=y
CONFIG_PARTITION_TABLE_CUSTOM=y
CONFIG_PARTITION_TABLE_CUSTOM_FILENAME="partitions.csv"
CONFIG_SPIRAM=y
CONFIG_SPIRAM_MODE_OCT=y
CONFIG_SPIRAM_SPEED_80M=y
CONFIG_SPIRAM_USE_MALLOC=y
CONFIG_ESP_CONSOLE_USB_SERIAL_JTAG=y
CONFIG_ESP_CONSOLE_SECONDARY_NONE=y
CONFIG_FREERTOS_HZ=1000
CONFIG_ESP_MAIN_TASK_STACK_SIZE=8192
CONFIG_MBEDTLS_CERTIFICATE_BUNDLE=y
CONFIG_MBEDTLS_CERTIFICATE_BUNDLE_DEFAULT_FULL=y
CONFIG_MBEDTLS_DYNAMIC_BUFFER=y
CONFIG_CJSON_NESTING_LIMIT=32
CONFIG_HTTPD_MAX_REQ_HDR_LEN=2048
CONFIG_HTTPD_MAX_URI_LEN=256
CONFIG_LWIP_SNTP_MAX_SERVERS=2
CONFIG_BT_ENABLED=y
CONFIG_BT_NIMBLE_ENABLED=y
CONFIG_BT_BLUEDROID_ENABLED=n
CONFIG_BT_NIMBLE_MAX_CONNECTIONS=1
CONFIG_BT_NIMBLE_HOST_TASK_STACK_SIZE=8192
CONFIG_ESP_PROTOCOMM_SUPPORT_SECURITY_VERSION_0=n
CONFIG_ESP_PROTOCOMM_SUPPORT_SECURITY_VERSION_1=n
CONFIG_ESP_PROTOCOMM_SUPPORT_SECURITY_VERSION_2=y
CONFIG_NETWORK_PROV_AUTOSTOP_TIMEOUT=30
CONFIG_BT_NIMBLE_ATT_PREFERRED_MTU=517

# HomeCraft BLE data energy policy; main XTAL retained for reliable BLE timing.
CONFIG_PM_ENABLE=y
CONFIG_FREERTOS_USE_TICKLESS_IDLE=y
CONFIG_BT_CTRL_MODEM_SLEEP=y
CONFIG_BT_CTRL_MODEM_SLEEP_MODE_1=y
CONFIG_BT_CTRL_LPCLK_SEL_MAIN_XTAL=y
CONFIG_BT_CTRL_MAIN_XTAL_PU_DURING_LIGHT_SLEEP=y
CONFIG_USJ_NO_AUTO_LS_ON_CONNECTION=y
CONFIG_ESP_DEFAULT_CPU_FREQ_MHZ_80=y
CONFIG_ESP_DEFAULT_CPU_FREQ_MHZ=80

CONFIG_PM_LIGHT_SLEEP_CALLBACKS=y

CONFIG_FATFS_API_ENCODING_UTF_8=y

# CONFIG_FATFS_API_ENCODING_ANSI_OEM is not set

CONFIG_FATFS_FS_LOCK=8

CONFIG_AUDIO_DECODER_AAC_SUPPORT=y

CONFIG_AUDIO_DECODER_MP3_SUPPORT=y

CONFIG_AUDIO_DECODER_G711_SUPPORT=y

# CONFIG_AUDIO_DECODER_AMRNB_SUPPORT is not set

# CONFIG_AUDIO_DECODER_AMRWB_SUPPORT is not set

CONFIG_AUDIO_DECODER_FLAC_SUPPORT=y

CONFIG_AUDIO_DECODER_OPUS_SUPPORT=y

CONFIG_AUDIO_DECODER_VORBIS_SUPPORT=y

CONFIG_AUDIO_DECODER_ADPCM_SUPPORT=y

CONFIG_AUDIO_DECODER_ALAC_SUPPORT=y

CONFIG_AUDIO_DECODER_PCM_SUPPORT=y

# CONFIG_AUDIO_DECODER_SBC_SUPPORT is not set

# CONFIG_AUDIO_DECODER_LC3_SUPPORT is not set

# CONFIG_AUDIO_DECODER_G722_SUPPORT is not set

CONFIG_AUDIO_SIMPLE_DEC_WAV_SUPPORT=y

CONFIG_AUDIO_SIMPLE_DEC_M4A_SUPPORT=y

# CONFIG_AUDIO_SIMPLE_DEC_TS_SUPPORT is not set

CONFIG_AUDIO_SIMPLE_DEC_OGG_SUPPORT=y

# CONFIG_AUDIO_ENCODER_AAC_SUPPORT is not set

# CONFIG_AUDIO_ENCODER_G711_SUPPORT is not set

# CONFIG_AUDIO_ENCODER_AMRNB_SUPPORT is not set

# CONFIG_AUDIO_ENCODER_AMRWB_SUPPORT is not set

# CONFIG_AUDIO_ENCODER_OPUS_SUPPORT is not set

# CONFIG_AUDIO_ENCODER_ADPCM_SUPPORT is not set

# CONFIG_AUDIO_ENCODER_ALAC_SUPPORT is not set

# CONFIG_AUDIO_ENCODER_PCM_SUPPORT is not set

# CONFIG_AUDIO_ENCODER_SBC_SUPPORT is not set

# CONFIG_AUDIO_ENCODER_LC3_SUPPORT is not set

# CONFIG_AUDIO_ENCODER_G722_SUPPORT is not set

CONFIG_CODEC_ES8311_SUPPORT=y

# CONFIG_CODEC_ES7210_SUPPORT is not set

# CONFIG_CODEC_ES7243_SUPPORT is not set

# CONFIG_CODEC_ES7243E_SUPPORT is not set

# CONFIG_CODEC_ES8156_SUPPORT is not set

# CONFIG_CODEC_AW88298_SUPPORT is not set

# CONFIG_CODEC_ES8389_SUPPORT is not set

# CONFIG_CODEC_ES8374_SUPPORT is not set

# CONFIG_CODEC_ES8388_SUPPORT is not set

# CONFIG_CODEC_TAS5805M_SUPPORT is not set

# CONFIG_CODEC_ZL38063_SUPPORT is not set

# CONFIG_CODEC_CJC8910_SUPPORT is not set

# CONFIG_CODEC_DUMMY_SUPPORT is not set

# CONFIG_CODEC_DATA_ADC_SUPPORT is not set

CONFIG_SPIRAM_MALLOC_ALWAYSINTERNAL=2048

CONFIG_SPIRAM_MALLOC_RESERVE_INTERNAL=65536
```

## reTerminalE1002/sdkconfig.defaults
```kconfig
# E1002-only HomeCraft profile. Factory partitions preserved; no account credentials.
CONFIG_IDF_TARGET="esp32s3"
CONFIG_ESPTOOLPY_FLASHSIZE_32MB=y
CONFIG_ESPTOOLPY_FLASHMODE_QIO=y
CONFIG_ESPTOOLPY_FLASHFREQ_80M=y
CONFIG_SPIRAM=y
CONFIG_SPIRAM_MODE_OCT=y
CONFIG_SPIRAM_SPEED_80M=y
CONFIG_ESP_CONSOLE_UART_DEFAULT=y
CONFIG_ESP_CONSOLE_UART_NUM=0
CONFIG_ESP_CONSOLE_SECONDARY_NONE=y
CONFIG_PARTITION_TABLE_CUSTOM=y
CONFIG_PARTITION_TABLE_CUSTOM_FILENAME="partitions.csv"
CONFIG_PARTITION_TABLE_OFFSET=0x8000
CONFIG_BT_ENABLED=y
CONFIG_BT_NIMBLE_ENABLED=y
CONFIG_BT_BLUEDROID_ENABLED=n
CONFIG_BT_NIMBLE_MAX_CONNECTIONS=1
CONFIG_BT_NIMBLE_HOST_TASK_STACK_SIZE=8192
CONFIG_BT_NIMBLE_ATT_PREFERRED_MTU=517
CONFIG_ESP_PROTOCOMM_SUPPORT_SECURITY_VERSION_0=n
CONFIG_ESP_PROTOCOMM_SUPPORT_SECURITY_VERSION_1=n
CONFIG_ESP_PROTOCOMM_SUPPORT_SECURITY_VERSION_2=y
CONFIG_LOG_DEFAULT_LEVEL_INFO=y
```
